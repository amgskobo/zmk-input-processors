/* SPDX-License-Identifier: MIT */
#include "../values.dtsi"
/ {
    raw_x {
        compatible = "zmk,input-processor-runtime-transform";
        #input-processor-cells = <0>;
        x-codes = <0 1 (-1)>;
        y-codes = <3 4 5>;
    };
    raw_scale {
        compatible = "zmk,input-processor-runtime-scaler";
        #input-processor-cells = <0>;
        codes = <0 1 (-1)>;
        multiplier = <1>;
        divisor = <1>;
    };
    raw_map {
        compatible = "zmk,input-processor-runtime-code-mapper";
        #input-processor-cells = <0>;
        map = <0 1 2 (-1)>;
    };
};
