/*
 * Copyright (c) 2026 amgskobo
 * SPDX-License-Identifier: MIT
 */

/* One past the divisor ceiling. */

#include "../values.dtsi"

/ {
    scale_divisor_over {
        compatible = "zmk,input-processor-runtime-scaler";
        #input-processor-cells = <0>;
        codes = <INPUT_REL_X>;
        multiplier = <1>;
        divisor = <32768>;
    };
};
