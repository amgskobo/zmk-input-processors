/*
 * Copyright (c) 2026 amgskobo
 * SPDX-License-Identifier: MIT
 */

#include <behaviors.dtsi>
#include <dt-bindings/zmk/keys.h>

/ {
    keymap {
        compatible = "zmk,keymap";

        base {
            bindings = <&kp A &kp B>;
        };

        pointer {
            bindings = <&trans &trans>;
        };
    };
};
