## drivers/input/Kconfig
```kconfig
# Copyright (c) 2022 The ZMK Contributors
# SPDX-License-Identifier: MIT

DT_COMPAT_ZMK_INPUT_PROCESSOR_ABSOLUTE_TO_RELATIVE := zmk,input-processor-absolute-to-relative

config ZMK_INPUT_PROCESSOR_ABSOLUTE_TO_RELATIVE
		bool
		default $(dt_compat_enabled,$(DT_COMPAT_ZMK_INPUT_PROCESSOR_ABSOLUTE_TO_RELATIVE))
		depends on ZMK_POINTING
        depends on (!ZMK_SPLIT || ZMK_SPLIT_ROLE_CENTRAL)


# The runtime processors. Each one keeps the parameters its upstream
# counterpart holds in rodata in RAM instead, and names them on the node, so
# they can be listed and changed while the keyboard runs. Selected by the
# devicetree, so a board that declares no such node compiles none of them.

DT_COMPAT_ZMK_INPUT_PROCESSOR_RUNTIME_SCALER := zmk,input-processor-runtime-scaler

config ZMK_INPUT_PROCESSOR_RUNTIME_SCALER
		bool
		default $(dt_compat_enabled,$(DT_COMPAT_ZMK_INPUT_PROCESSOR_RUNTIME_SCALER))
		depends on ZMK_POINTING

DT_COMPAT_ZMK_INPUT_PROCESSOR_RUNTIME_TRANSFORM := zmk,input-processor-runtime-transform

config ZMK_INPUT_PROCESSOR_RUNTIME_TRANSFORM
		bool
		default $(dt_compat_enabled,$(DT_COMPAT_ZMK_INPUT_PROCESSOR_RUNTIME_TRANSFORM))
		depends on ZMK_POINTING

DT_COMPAT_ZMK_INPUT_PROCESSOR_RUNTIME_CODE_MAPPER := zmk,input-processor-runtime-code-mapper

config ZMK_INPUT_PROCESSOR_RUNTIME_CODE_MAPPER
		bool
		default $(dt_compat_enabled,$(DT_COMPAT_ZMK_INPUT_PROCESSOR_RUNTIME_CODE_MAPPER))
		depends on ZMK_POINTING

config ZMK_INPUT_PROCESSORS_CUSTOM_SETTINGS
	bool "Publish input processor parameters through zmk-feature-custom-settings"
	depends on ZMK_CUSTOM_SETTINGS
	help
	  Registers this module's processor parameters in the cross-module custom
	  settings registry, so a Studio client lists and edits them with no page
	  of its own: the declared type and range drive the widget. The registry
	  then owns persistence, and the drivers store nothing, so there is one
	  owner for each value. Needs zmk-feature-custom-settings, and so the
	  patched ZMK that carries the custom Studio RPC protocol; with this off,
	  which is the default and what an upstream ZMK build gets, none of it is
	  compiled and the devicetree values are fixed.
```

## dts/bindings/zmk,input-processor-absolute-to-relative.yaml
```yaml
# Copyright (c) 2024 The ZMK Contributors
# SPDX-License-Identifier: MIT

description: Converts absolute pointer coordinates into relative motion, smoothed over two samples

compatible: "zmk,input-processor-absolute-to-relative"

include: ip_zero_param.yaml

properties:
  suppress-btn-touch:
    description: >-
      If true, the input processor will suppress INPUT_BTN_TOUCH events (used
      to control touch state) so they are not forwarded to downstream
      consumers.
    type: boolean
  suppress-btn0:
    description: >-
      If true, the input processor will suppress INPUT_BTN_0 events so they
      are not forwarded to downstream consumers.
    type: boolean
  setting-name:
    type: string
    description: >-
      Short name for this instance in custom settings keys, in place of its
      devicetree instance number. A board routes several instances of this
      processor, and in a client they are otherwise identically named rows told
      apart only by a number whose order comes from however devicetree happened
      to enumerate the nodes. The whole key is capped at 48 bytes.
```

## dts/bindings/zmk,input-processor-runtime-code-mapper.yaml
```yaml
# Copyright (c) 2026 amgskobo
# SPDX-License-Identifier: MIT

description: |
  Rewrites event codes from a from/to table, with a switch held on the node.

  Unlike zmk,input-processor-code-mapper the map can be turned off while the
  keyboard runs. That is the one question a mapper has worth asking at runtime,
  and it is what turns a scroll route back into a pointer route without a layer
  or a rebuild. Disabled, the processor is a no-op rather than absent, so the
  chain keeps its shape and the stage can be switched back on.

compatible: "zmk,input-processor-runtime-code-mapper"

include: ip_zero_param.yaml

properties:
  type:
    type: int
    default: 2
    description: >-
      Event type to act on, from dt-bindings/zmk/input_transform.h. The default
      is INPUT_EV_REL (2).
  map:
    type: array
    required: true
    description: >-
      From/to code pairs, flattened: an even number of entries, each odd entry
      the code to match and the following one the code it becomes. The first
      match wins and no further pair is considered, so a chain of rewrites is
      not possible in one instance.
  start-disabled:
    type: boolean
    description: >-
      Start with the map switched off. A Zephyr boolean is presence-based and
      so cannot default to true, which is why the devicetree property is the
      negative one while the setting a client sees is "enabled".
  setting-name:
    type: string
    description: >-
      Short name for this instance in custom settings keys, in place of its
      devicetree instance number. A board routes several instances of the same
      processor, and in a client they are otherwise identically named rows told
      apart only by a number whose order comes from however devicetree happened
      to enumerate the nodes. The whole key is capped at 48 bytes.
```

## dts/bindings/zmk,input-processor-runtime-scaler.yaml
```yaml
# Copyright (c) 2026 amgskobo
# SPDX-License-Identifier: MIT

description: |
  Scales relative pointer events by a ratio held on the node.

  Unlike zmk,input-processor-scaler the ratio is a property rather than a pair
  of chain parameter cells, so it names a value a client can change while the
  keyboard runs, and the arithmetic is done in 64 bits, so a large multiplier
  cannot turn a fast movement backwards.

compatible: "zmk,input-processor-runtime-scaler"

include: ip_zero_param.yaml

properties:
  type:
    type: int
    default: 2
    description: >-
      Event type to act on, from
      zephyr/dt-bindings/input/input-event-codes.h. The default is INPUT_EV_REL
      (2).
  codes:
    type: array
    required: true
    description: >-
      Event codes to scale. Codes not listed here pass through untouched.
  multiplier:
    type: int
    required: true
    description: >-
      Numerator of the ratio, 0 to 32767. This is the starting value; the
      running value can be changed at runtime. Zero is how a chain kills one
      axis, scaling it by 0/1 rather than carrying a processor to drop it.
  divisor:
    type: int
    required: true
    description: >-
      Denominator of the ratio, 1 to 32767. Together with multiplier a value of
      889/500 means 1.778x. The bound is what keeps the tracked remainder
      inside the int16_t slot ZMK provides for it.
```

## dts/bindings/zmk,input-processor-runtime-temp-layer.yaml
```yaml
# Copyright (c) 2026 amgskobo
# SPDX-License-Identifier: MIT

description: |
  Raises a layer while a pointer is in use, with its numbers held on the node.

  Unlike zmk,input-processor-temp-layer the layer and the timeout are named
  properties rather than chain parameter cells, so all three numbers can be
  listed and changed while the keyboard runs. They are the values a person
  revises after living with a pointer for a week.

  excluded-positions stays structural. A list of key positions is not something
  a generic settings list can draw, and it belongs to the physical layout
  rather than to taste.

compatible: "zmk,input-processor-runtime-temp-layer"

include: ip_zero_param.yaml

properties:
  layer:
    type: int
    required: true
    description: >-
      Layer to raise, as a layer ID -- the same thing zmk_keymap_layer_activate
      takes, not a position in the keymap. The two agree until layers are
      reordered, and diverge afterwards.
  timeout-ms:
    type: int
    required: true
    description: >-
      Milliseconds of pointer silence before the layer drops. Zero leaves the
      layer up until a key outside excluded-positions is pressed. Must be from
      0 through 60000.
  require-prior-idle-ms:
    type: int
    default: 0
    description: >-
      Milliseconds after a key press during which the layer will not come up.
      This is what stops a brush against the pad mid-word from turning the next
      key into a click. Zero disables the guard; the maximum is 60000.
  excluded-positions:
    type: array
    description: >-
      Key positions that do not drop the layer: the clicks, side buttons and
      anything else the pointer hand reaches for while the layer is up. Every
      other press drops it immediately. With no list at all, no key press drops
      the layer and only the timeout does.
  start-disabled:
    type: boolean
    description: >-
      Start with the processor switched off, so it raises nothing. This is the
      stage's no-op: every other processor here passes through at some value of
      its own, but a timeout of zero means "never drop by timeout" rather than
      "never raise", so the switch has to be explicit. A Zephyr boolean is
      presence-based and so cannot default to true, which is why the devicetree
      property is the negative one while the setting a client sees is "enabled".
```

## dts/bindings/zmk,input-processor-runtime-transform.yaml
```yaml
# Copyright (c) 2026 amgskobo
# SPDX-License-Identifier: MIT

description: |
  Swaps and inverts pointer axes, with the orientation held on the node.

  Unlike zmk,input-processor-transform the three flags are named properties
  rather than bits of a chain parameter cell, so each one is a value a client
  can list and change while the keyboard runs. A trackpad mounted the other
  way up is then a checkbox rather than a rebuild.

compatible: "zmk,input-processor-runtime-transform"

include: ip_zero_param.yaml

properties:
  type:
    type: int
    default: 2
    description: >-
      Event type to act on, from
      zephyr/dt-bindings/input/input-event-codes.h. The default is INPUT_EV_REL
      (2).
  x-codes:
    type: array
    required: true
    description: >-
      Codes travelling on the X axis. Paired with y-codes by index, which is
      how a swap knows what to exchange, so the two must be the same length.
  y-codes:
    type: array
    required: true
    description: Codes travelling on the Y axis. Same length as x-codes.
  xy-swap:
    type: boolean
    description: >-
      Starting state: exchange the X and Y codes. Applied before either
      inversion, so an inversion acts on the axis an event ends up on.
  x-invert:
    type: boolean
    description: "Starting state: negate values travelling on the X axis."
  y-invert:
    type: boolean
    description: "Starting state: negate values travelling on the Y axis."
```

## tests/integration/firmware/boards/shields/runtime_processors_split/Kconfig.defconfig
```kconfig
# Copyright (c) 2026 amgskobo
# SPDX-License-Identifier: MIT

if SHIELD_RUNTIME_PROCESSORS_SPLIT_LEFT

config ZMK_KEYBOARD_NAME
    default "RT Split Test"

config ZMK_SPLIT_ROLE_CENTRAL
    default y

endif

if SHIELD_RUNTIME_PROCESSORS_SPLIT_LEFT || SHIELD_RUNTIME_PROCESSORS_SPLIT_RIGHT

config ZMK_SPLIT
    default y

endif
```

## tests/integration/firmware/boards/shields/runtime_processors_split/Kconfig.shield
```kconfig
# Copyright (c) 2026 amgskobo
# SPDX-License-Identifier: MIT

config SHIELD_RUNTIME_PROCESSORS_SPLIT_LEFT
    def_bool $(shields_list_contains,runtime_processors_split_left)

config SHIELD_RUNTIME_PROCESSORS_SPLIT_RIGHT
    def_bool $(shields_list_contains,runtime_processors_split_right)
```

## tests/integration/firmware/boards/shields/runtime_processors_test/Kconfig.defconfig
```kconfig
# Copyright (c) 2026 amgskobo
# SPDX-License-Identifier: MIT

if SHIELD_RUNTIME_PROCESSORS_TEST

config ZMK_KEYBOARD_NAME
    default "RT Proc Test"

endif
```

## tests/integration/firmware/boards/shields/runtime_processors_test/Kconfig.shield
```kconfig
# Copyright (c) 2026 amgskobo
# SPDX-License-Identifier: MIT

config SHIELD_RUNTIME_PROCESSORS_TEST
    def_bool $(shields_list_contains,runtime_processors_test)
```

## tests/integration/runtime/module/Kconfig
```kconfig
# Copyright (c) 2026 amgskobo
# SPDX-License-Identifier: MIT

config ZMK_INPUT_PROCESSORS_TEST_DRIVERS
    bool "Run the runtime processor driver self-tests at boot"
    depends on ZMK_POINTING

config ZMK_INPUT_PROCESSORS_TEST_SETTINGS
    bool "Run the runtime processor settings self-tests at boot"
    depends on ZMK_INPUT_PROCESSORS_CUSTOM_SETTINGS

config ZMK_INPUT_PROCESSORS_TEST_DEFAULTS
    bool "Check the module's ready-made nodes against their documented defaults at boot"
    depends on ZMK_INPUT_PROCESSORS_CUSTOM_SETTINGS

config ZMK_INPUT_PROCESSORS_TEST_PERSISTENCE
    bool "Store settings on the first boot and check they are applied on the second"
    depends on ZMK_INPUT_PROCESSORS_CUSTOM_SETTINGS && SETTINGS_NVS
```

## tests/requeue/module/Kconfig
```kconfig
config ZMK_INPUT_PROCESSORS_REQUEUE_TEST
    bool "Temporary-layer running activation requeue test"
```

## tests/transition-lock/module/Kconfig
```kconfig
# Copyright (c) 2026 amgskobo; SPDX-License-Identifier: MIT
config ZMK_INPUT_PROCESSORS_TRANSITION_LOCK_TEST
    bool "Runtime temporary-layer cross-instance transition lock test"
```
