
/ {
    zip_absolute_to_relative: zip_absolute_to_relative {
        status = "okay";
        compatible = "zmk,input-processor-absolute-to-relative";
        #input-processor-cells = <0>;
        /* Example properties (set to <1> to enable) */
        /* If set to <1>, INPUT_BTN_TOUCH events are suppressed (not forwarded). */
        suppress-btn-touch;
        /* If set to <1>, INPUT_BTN_0 events are suppressed (not forwarded). */
        suppress-btn0;
    };
};